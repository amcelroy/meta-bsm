## conf/layer.conf
```bitbake
# We have a conf and classes directory, add to BBPATH
BBPATH .= ":${LAYERDIR}"

# We have recipes-* directories, add to BBFILES
BBFILES += "${LAYERDIR}/recipes-*/*/*.bb \
            ${LAYERDIR}/recipes-*/*/*.bbappend"

BBFILE_COLLECTIONS += "meta-bsm"
BBFILE_PATTERN_meta-bsm = "^${LAYERDIR}/"
BBFILE_PRIORITY_meta-bsm = "6"

LAYERDEPENDS_meta-bsm = "core"
LAYERSERIES_COMPAT_meta-bsm = "dunfell"
```
